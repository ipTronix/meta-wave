## conf/machine/waveq.conf
```bitbake
#@TYPE: Machine
#@NAME: North Invent Wave Evolution
#@SOC: i.MX6Q
#@DESCRIPTION: Machine configuration for North Invent Wave Evolution on iMX6q
#@MAINTAINER: Masssimiliano Agneni <massimiliano.agneni@iptronix.com>

require conf/machine/include/wave-common.inc

SOC_FAMILY = "mx6:mx6q"

KERNEL_DEVICETREE = "waveq.dtb "

UBOOT_CONFIG ??= "sd"
UBOOT_CONFIG[sd] = "waveq_config,sdcard"
UBOOT_CONFIG[mfgtool] = "waveq_config"
```

## conf/machine/waves.conf
```bitbake
#@TYPE: Machine
#@NAME: North Invent Wave Evolution
#@SOC: i.MX6DL
#@DESCRIPTION: Machine configuration for North Invent Wave Evolution on iMX6s
#@MAINTAINER: Masssimiliano Agneni <massimiliano.agneni@iptronix.com>

require conf/machine/include/mx6qroj-common.inc

SOC_FAMILY = "mx6:mx6dl"

KERNEL_DEVICETREE = "waves.dtb"

UBOOT_CONFIG ??= "sd"
UBOOT_CONFIG[sd] = "waves_config,sdcard"
UBOOT_CONFIG[mfgtool] = "waves_config"
```
